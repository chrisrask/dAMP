/*
 * functions.c
 *
 *  Created on: Feb 11, 2022
 *      Author: pvh318
 */

#include "main.h"
#include "functions.h"
#include "ssd1306.h"
#include "math.h"

int count1 = 0, count2 = 0, fSpd;
int fSpd, fan = 65535;
int32_t CH1_DC = 0;


int pbSelection(){
	if (HAL_GPIO_ReadPin(pButton_GPIO_Port, pButton_Pin) == LOW){
		HAL_Delay(250);
		selector++;
		if (selector > 2){
			selector = 0;
		}
	}
	return selector;
}

int countGain(TIM_HandleTypeDef *htim){
	static unsigned long lastInterruptTime = 0;
	unsigned long interruptTime = HAL_GetTick();

	if (interruptTime - lastInterruptTime > 10){
		count1 = __HAL_TIM_GET_COUNTER(htim);
		if (count1 > count2){

			counterGain++;
		}
		else if (count1 < count2){
			counterGain--;
		}
	}
	if (counterGain >= 10){
		counterGain = 10;
	}
	else if (counterGain <= 2){
		counterGain = 2;
	}

	cGain = counterGain / 2;
	//switch
	switch(cGain){
		case 2:
			cGain = 3;
			break;
		case 3:
			cGain = 5;
			break;
		case 4:
			cGain = 7;
			break;
		case 5:
			cGain = 11;
			break;
		default:
			cGain = 1;
			break;
		}
	count2 = count1;
	lastInterruptTime = interruptTime;
	return cGain;
}

float countImpedance(TIM_HandleTypeDef *htim){

	static unsigned long lastInterruptTime = 0;
	unsigned long interruptTime = HAL_GetTick();

	if (interruptTime - lastInterruptTime > 10){
		count1 = __HAL_TIM_GET_COUNTER(htim);
		if (count1 > count2){
			counterImp++;
		}
		else if (count1 < count2){
			counterImp--;
		}
		if (counterImp > 4){
			counterImp = 4;
		}
		else if (counterImp <= 0){
			counterImp = 0;
		}
	}

	i = counterImp / 2;
	cImpedance = (float)i / 2;
	aLastState = aState;
	count2 = count1;
	lastInterruptTime = interruptTime;
	return cImpedance;
}

void print(char gainS[2], char impS[10], char relayStatusS[5], char stabS[2], char fanSpdS[3], int selection, char temp_cS[3]){

	  ssd1306_Fill(Black);
	  ssd1306_SetCursor(0, 0);
	  ssd1306_WriteString("Gain: ", Font_7x10, White);

	  ssd1306_SetCursor(0, 10);
	  ssd1306_WriteString("Impedance: ", Font_7x10, White);

	  ssd1306_SetCursor(0, 20);
	  ssd1306_WriteString("Stab:", Font_7x10, White);

	  ssd1306_SetCursor(0, 30);
	  ssd1306_WriteString("Temp: ", Font_7x10, White);

	  ssd1306_SetCursor(0, 40);
	  ssd1306_WriteString("Fan spd: ", Font_7x10, White);

	  ssd1306_SetCursor(0, 50);
	  ssd1306_WriteString("Relay:", Font_7x10, White);

	  //Gain
	  ssd1306_SetCursor(100, 0);
	  ssd1306_WriteString(gainS, Font_7x10, White);

	  //Impedance
	  ssd1306_SetCursor(100, 10);
	  ssd1306_WriteString(impS, Font_7x10, White);

	  //Stabilization
	  ssd1306_SetCursor(100, 20);
	  ssd1306_WriteString(stabS, Font_7x10, White);

	  //Temperature
	  ssd1306_SetCursor(100, 30);
	  ssd1306_WriteString(temp_cS, Font_7x10, White);

	  // Fan speed
	  ssd1306_SetCursor(100, 40);
	  ssd1306_WriteString(fanSpdS, Font_7x10, White);

	  // Relay status
	  ssd1306_SetCursor(100, 50);
	  ssd1306_WriteString(relayStatusS, Font_7x10, White);

	  //Arrow
	  if (selection == 0){
		  ssd1306_SetCursor(85, 0);
		  ssd1306_WriteString("->", Font_7x10, White);
	  }
	  else if (selection == 1){
		  ssd1306_SetCursor(85, 10);
		  ssd1306_WriteString("->", Font_7x10, White);
	  }
	  else{
		  ssd1306_SetCursor(85, 20);
		  ssd1306_WriteString("->", Font_7x10, White);
	  }

	  //Update screen
	  ssd1306_UpdateScreen();
}

int amplify(int gain){
	// Relay for 1x or higher amplification
	switch (gain){
		case 1:
			relay = 1;
			HAL_GPIO_WritePin(opRelay_GPIO_Port, opRelay_Pin, GPIO_PIN_SET);
			HAL_GPIO_WritePin(mux1_GPIO_Port, mux1_Pin, GPIO_PIN_RESET);
			HAL_GPIO_WritePin(mux2_GPIO_Port, mux2_Pin, GPIO_PIN_RESET);
			HAL_GPIO_WritePin(mux3_GPIO_Port, mux3_Pin, GPIO_PIN_RESET);
			HAL_GPIO_WritePin(mux4_GPIO_Port, mux4_Pin, GPIO_PIN_RESET);
			break;
		case 3:
			relay = 3;
			HAL_GPIO_WritePin(opRelay_GPIO_Port, opRelay_Pin, GPIO_PIN_RESET);
			HAL_GPIO_WritePin(mux1_GPIO_Port, mux1_Pin, GPIO_PIN_SET);
			HAL_GPIO_WritePin(mux2_GPIO_Port, mux2_Pin, GPIO_PIN_RESET);
			HAL_GPIO_WritePin(mux3_GPIO_Port, mux3_Pin, GPIO_PIN_RESET);
			HAL_GPIO_WritePin(mux4_GPIO_Port, mux4_Pin, GPIO_PIN_RESET);
			break;
		case 5:
			relay = 5;
			HAL_GPIO_WritePin(opRelay_GPIO_Port, opRelay_Pin, GPIO_PIN_RESET);
			HAL_GPIO_WritePin(mux1_GPIO_Port, mux1_Pin, GPIO_PIN_RESET);
			HAL_GPIO_WritePin(mux2_GPIO_Port, mux2_Pin, GPIO_PIN_SET);
			HAL_GPIO_WritePin(mux3_GPIO_Port, mux3_Pin, GPIO_PIN_RESET);
			HAL_GPIO_WritePin(mux4_GPIO_Port, mux4_Pin, GPIO_PIN_RESET);
			break;
		case 7:
			relay = 7;
			HAL_GPIO_WritePin(opRelay_GPIO_Port, opRelay_Pin, GPIO_PIN_RESET);
			HAL_GPIO_WritePin(mux1_GPIO_Port, mux1_Pin, GPIO_PIN_RESET);
			HAL_GPIO_WritePin(mux2_GPIO_Port, mux2_Pin, GPIO_PIN_RESET);
			HAL_GPIO_WritePin(mux3_GPIO_Port, mux3_Pin, GPIO_PIN_SET);
			HAL_GPIO_WritePin(mux4_GPIO_Port, mux4_Pin, GPIO_PIN_RESET);
			break;
		default:
			relay = 11;
			HAL_GPIO_WritePin(opRelay_GPIO_Port, opRelay_Pin, GPIO_PIN_RESET);
			HAL_GPIO_WritePin(mux1_GPIO_Port, mux1_Pin, GPIO_PIN_RESET);
			HAL_GPIO_WritePin(mux2_GPIO_Port, mux2_Pin, GPIO_PIN_RESET);
			HAL_GPIO_WritePin(mux3_GPIO_Port, mux3_Pin, GPIO_PIN_RESET);
			HAL_GPIO_WritePin(mux4_GPIO_Port, mux4_Pin, GPIO_PIN_SET);
			break;
	}
	return relay;
}

void outImp(float impedance){
	if (impedance == 1){
			HAL_GPIO_WritePin(outImp1_GPIO_Port, outImp1_Pin, GPIO_PIN_SET);
			HAL_GPIO_WritePin(outImp2_GPIO_Port, outImp2_Pin, GPIO_PIN_RESET);
	}
	else if (impedance == 0.5){
			HAL_GPIO_WritePin(outImp1_GPIO_Port, outImp1_Pin, GPIO_PIN_RESET);
			HAL_GPIO_WritePin(outImp2_GPIO_Port, outImp2_Pin, GPIO_PIN_SET);
	}
	else{
			HAL_GPIO_WritePin(LD2_GPIO_Port, LD2_Pin, GPIO_PIN_RESET);
			HAL_GPIO_WritePin(outImp2_GPIO_Port, outImp2_Pin, GPIO_PIN_RESET);
	}
}

int countStab(TIM_HandleTypeDef *htim){

	static unsigned long lastInterruptTime = 0;
	unsigned long interruptTime = HAL_GetTick();

	if (interruptTime - lastInterruptTime > 10){
		count1 = __HAL_TIM_GET_COUNTER(htim);
		if (count1 > count2){
			counterStab++;
		}
		else if (count1 < count2){
			counterStab--;
		}
		if (counterStab >= 2){
			counterStab = 2;
		}
		else if (counterStab <= 0){
			counterStab = 0;
		}
	}
	cStab = counterStab / 2;
	count2 = count1;
	lastInterruptTime = interruptTime;
	return cStab;
}

int fanSet(TIM_HandleTypeDef *htim){

	static unsigned long lastInterruptTime = 0;
	unsigned long interruptTime = HAL_GetTick();

	if (interruptTime - lastInterruptTime > 10){
		count1 = __HAL_TIM_GET_COUNTER(htim);
		if (count1 > count2){
			counterFan++;
		}
		else if (count1 < count2){
			counterFan--;
		}
		if (counterFan >= 10){
			counterFan = 10;
		}
		else if (counterFan <= 0){
			counterFan = 0;
		}
	}

	fanSel = counterFan / 2;
	count2 = count1;
	lastInterruptTime = interruptTime;
	return fanSel;
}

int fanCtrl(TIM_HandleTypeDef *htim , int temp_c){


	if (temp_c > 20){
		fSpd = (fan * temp_c) / 100;
	}
	else {
		fSpd = (fan * 20) / 100;
	}
	if (temp_c > 100){
		fSpd = fan;
	}


	TIM1->CCR1 = fSpd;


	return fSpd;

}

int tempWarning(int temp_c){
	ssd1306_Fill(Black);
	ssd1306_SetCursor(55, 0);
	ssd1306_WriteString("CAUTION TEMP!", , color)
	ssd1306_SetCursor(55, 30);
	ssd1306_WriteChar(temp_c, Font_16x26, White);
	ssd1306_UpdateScreen();
	HAL_Delay(500);
	ssd1306_Fill(White);
	ssd1306_SetCursor(55, 0);
	ssd1306_WriteChar("CAUTION TEMP!", Font_16x26, Black);
	ssd1306_SetCursor(55, 30);
	ssd1306_WriteChar(temp_c, Font_16x26, Black);
	ssd1306_UpdateScreen();
}





unsigned char afry_128x64 [] = {
0xFF, 0xFF, 0xFF, 0xFF, 0xFF, 0xFF, 0xFF, 0xFF, 0xFF, 0xFF, 0xFF, 0xFF, 0xFF, 0xFF, 0xFF, 0xFF,
0xFF, 0xFF, 0xFF, 0xFF, 0xFF, 0xFF, 0xFF, 0xFF, 0xFF, 0xFF, 0xFF, 0xFF, 0xFF, 0xFF, 0xFF, 0xFF,
0xFF, 0xFF, 0xFF, 0xFF, 0xFF, 0xFF, 0xFF, 0xFF, 0xFF, 0xFF, 0xFF, 0xFF, 0xFF, 0xFF, 0xFF, 0xFF,
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0xFF, 0xFF, 0xFF, 0xFF, 0xFF, 0xFF, 0xFF, 0xFF, 0xFF, 0xFF, 0xFF, 0xFF, 0xFF, 0xFF, 0xFF, 0xFF
};

unsigned char pepe_128x64 [] = {
0x00, 0x00, 0x00, 0x00, 0x00, 0x00, 0x00, 0x00, 0x00, 0x00, 0x00, 0x00, 0x00, 0x00, 0x00, 0x00,
0x00, 0x00, 0x00, 0x00, 0x00, 0x00, 0x00, 0x00, 0x00, 0x00, 0x00, 0x00, 0x00, 0x00, 0x00, 0x00,
0x00, 0x00, 0x00, 0x00, 0x00, 0x00, 0x00, 0x00, 0x00, 0x00, 0x00, 0x00, 0x00, 0x00, 0x00, 0x00,
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0x00, 0x00, 0x00, 0x00, 0x00, 0x00, 0x00, 0x00, 0x00, 0x00, 0x00, 0x00, 0x00, 0x00, 0x00, 0x00
};
